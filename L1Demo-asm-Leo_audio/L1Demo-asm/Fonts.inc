FontStart:

	; classic 8x6 bitmapped font
	.byte 0x00, 0x00
	.byte 0x00, 0x00	; first char
	.byte 0x7F, 0x00	; last  char
	.byte 0x08, 0x00	; height
	; glyph table
	.byte 6 	; width 0
	.byte 8,2,0
	.byte 6 	; width 1
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	.byte 0,6,0
	.byte 0x00,0x00,0x00,0x00,0x00,0x00,0x00,0x00	; 0x00
	.byte 0x1C,0x22,0x36,0x22,0x2A,0x22,0x1C,0x00	; 0x01
	.byte 0x1C,0x3E,0x2A,0x3E,0x22,0x3E,0x1C,0x00	; 0x02
	.byte 0x00,0x14,0x3E,0x3E,0x3E,0x1C,0x08,0x00	; 0x03
	.byte 0x00,0x08,0x1C,0x3E,0x3E,0x1C,0x08,0x00	; 0x04
	.byte 0x08,0x1C,0x1C,0x08,0x3E,0x3E,0x08,0x00	; 0x05
	.byte 0x00,0x08,0x1C,0x3E,0x3E,0x08,0x1C,0x00	; 0x06
	.byte 0x00,0x00,0x00,0x00,0x00,0x00,0x00,0x00	; 0x07
	.byte 0x00,0x00,0x00,0x00,0x00,0x00,0x00,0x00	; 0x08
	.byte 0x00,0x00,0x00,0x00,0x00,0x00,0x00,0x00	; 0x09
	.byte 0x00,0x00,0x00,0x00,0x00,0x00,0x00,0x00	; 0x0A
	.byte 0x00,0x38,0x30,0x2C,0x12,0x12,0x0C,0x00	; 0x0B
	.byte 0x1C,0x22,0x22,0x1C,0x08,0x1C,0x08,0x00	; 0x0C
	.byte 0x00,0x00,0x00,0x00,0x00,0x00,0x00,0x00	; 0x0D
	.byte 0x30,0x2C,0x34,0x2C,0x34,0x36,0x06,0x00	; 0x0E
	.byte 0x00,0x2A,0x1C,0x36,0x1C,0x2A,0x00,0x00	; 0x0F
	.byte 0x04,0x0C,0x1C,0x3C,0x1C,0x0C,0x04,0x00	; 0x10
	.byte 0x10,0x18,0x1C,0x1E,0x1C,0x18,0x10,0x00	; 0x11
	.byte 0x08,0x1C,0x3E,0x08,0x3E,0x1C,0x08,0x00	; 0x12
	.byte 0x14,0x14,0x14,0x14,0x14,0x00,0x14,0x00	; 0x13
	.byte 0x3C,0x2A,0x2A,0x2C,0x28,0x28,0x28,0x00	; 0x14
	.byte 0x1C,0x22,0x0C,0x14,0x18,0x22,0x1C,0x00	; 0x15
	.byte 0x00,0x00,0x00,0x00,0x00,0x1E,0x1E,0x00	; 0x16
	.byte 0x08,0x1C,0x3E,0x08,0x3E,0x1C,0x08,0x1C	; 0x17
	.byte 0x08,0x1C,0x3E,0x08,0x08,0x08,0x08,0x00	; 0x18
	.byte 0x08,0x08,0x08,0x08,0x3E,0x1C,0x08,0x00	; 0x19
	.byte 0x00,0x08,0x18,0x3E,0x18,0x08,0x00,0x00	; 0x1A
	.byte 0x00,0x08,0x0C,0x3E,0x0C,0x08,0x00,0x00	; 0x1B
	.byte 0x00,0x00,0x00,0x02,0x02,0x02,0x3E,0x00	; 0x1C
	.byte 0x00,0x14,0x14,0x3E,0x14,0x14,0x00,0x00	; 0x1D
	.byte 0x08,0x08,0x1C,0x1C,0x3E,0x3E,0x00,0x00	; 0x1E
	.byte 0x3E,0x3E,0x1C,0x1C,0x08,0x08,0x00,0x00	; 0x1F
	.byte 0x00,0x00,0x00,0x00,0x00,0x00,0x00,0x00	; 0x20
	.byte 0x08,0x1C,0x1C,0x08,0x08,0x00,0x08,0x00	; 0x21
	.byte 0x36,0x36,0x12,0x00,0x00,0x00,0x00,0x00	; 0x22
	.byte 0x00,0x14,0x3E,0x14,0x14,0x3E,0x14,0x00	; 0x23
	.byte 0x04,0x1C,0x02,0x0C,0x10,0x0E,0x08,0x00	; 0x24
	.byte 0x26,0x26,0x10,0x08,0x04,0x32,0x32,0x00	; 0x25
	.byte 0x04,0x0A,0x0A,0x04,0x2A,0x12,0x2C,0x00	; 0x26
	.byte 0x0C,0x0C,0x04,0x00,0x00,0x00,0x00,0x00	; 0x27
	.byte 0x08,0x04,0x04,0x04,0x04,0x04,0x08,0x00	; 0x28
	.byte 0x04,0x08,0x08,0x08,0x08,0x08,0x04,0x00	; 0x29
	.byte 0x00,0x14,0x1C,0x3E,0x1C,0x14,0x00,0x00	; 0x2A
	.byte 0x00,0x08,0x08,0x3E,0x08,0x08,0x00,0x00	; 0x2B
	.byte 0x00,0x00,0x00,0x00,0x00,0x0C,0x0C,0x04	; 0x2C
	.byte 0x00,0x00,0x00,0x3E,0x00,0x00,0x00,0x00	; 0x2D
	.byte 0x00,0x00,0x00,0x00,0x00,0x0C,0x0C,0x00	; 0x2E
	.byte 0x00,0x20,0x10,0x08,0x04,0x02,0x00,0x00	; 0x2F
	.byte 0x1C,0x22,0x32,0x2A,0x26,0x22,0x1C,0x00	; 0x30
	.byte 0x08,0x0C,0x08,0x08,0x08,0x08,0x1C,0x00	; 0x31
	.byte 0x1C,0x22,0x20,0x18,0x04,0x02,0x3E,0x00	; 0x32
	.byte 0x1C,0x22,0x20,0x1C,0x20,0x22,0x1C,0x00	; 0x33
	.byte 0x10,0x18,0x14,0x12,0x3E,0x10,0x10,0x00	; 0x34
	.byte 0x3E,0x02,0x02,0x1E,0x20,0x22,0x1C,0x00	; 0x35
	.byte 0x18,0x04,0x02,0x1E,0x22,0x22,0x1C,0x00	; 0x36
	.byte 0x3E,0x20,0x10,0x08,0x04,0x04,0x04,0x00	; 0x37
	.byte 0x1C,0x22,0x22,0x1C,0x22,0x22,0x1C,0x00	; 0x38
	.byte 0x1C,0x22,0x22,0x3C,0x20,0x10,0x0C,0x00	; 0x39
	.byte 0x00,0x00,0x0C,0x0C,0x00,0x0C,0x0C,0x00	; 0x3A
	.byte 0x00,0x00,0x0C,0x0C,0x00,0x0C,0x0C,0x04	; 0x3B
	.byte 0x10,0x08,0x04,0x02,0x04,0x08,0x10,0x00	; 0x3C
	.byte 0x00,0x00,0x3E,0x00,0x00,0x3E,0x00,0x00	; 0x3D
	.byte 0x04,0x08,0x10,0x20,0x10,0x08,0x04,0x00	; 0x3E
	.byte 0x1C,0x22,0x20,0x18,0x08,0x00,0x08,0x00	; 0x3F
	.byte 0x1C,0x22,0x3A,0x2A,0x3A,0x02,0x1C,0x00	; 0x40
	.byte 0x1C,0x22,0x22,0x22,0x3E,0x22,0x22,0x00	; 0x41
	.byte 0x1E,0x22,0x22,0x1E,0x22,0x22,0x1E,0x00	; 0x42
	.byte 0x1C,0x22,0x02,0x02,0x02,0x22,0x1C,0x00	; 0x43
	.byte 0x1E,0x22,0x22,0x22,0x22,0x22,0x1E,0x00	; 0x44
	.byte 0x3E,0x02,0x02,0x1E,0x02,0x02,0x3E,0x00	; 0x45
	.byte 0x3E,0x02,0x02,0x1E,0x02,0x02,0x02,0x00	; 0x46
	.byte 0x1C,0x22,0x02,0x3A,0x22,0x22,0x3C,0x00	; 0x47
	.byte 0x22,0x22,0x22,0x3E,0x22,0x22,0x22,0x00	; 0x48
	.byte 0x1C,0x08,0x08,0x08,0x08,0x08,0x1C,0x00	; 0x49
	.byte 0x20,0x20,0x20,0x20,0x22,0x22,0x1C,0x00	; 0x4A
	.byte 0x22,0x12,0x0A,0x06,0x0A,0x12,0x22,0x00	; 0x4B
	.byte 0x02,0x02,0x02,0x02,0x02,0x02,0x3E,0x00	; 0x4C
	.byte 0x22,0x36,0x2A,0x22,0x22,0x22,0x22,0x00	; 0x4D
	.byte 0x22,0x26,0x2A,0x32,0x22,0x22,0x22,0x00	; 0x4E
	.byte 0x1C,0x22,0x22,0x22,0x22,0x22,0x1C,0x00	; 0x4F
	.byte 0x1E,0x22,0x22,0x1E,0x02,0x02,0x02,0x00	; 0x50
	.byte 0x1C,0x22,0x22,0x22,0x2A,0x12,0x2C,0x00	; 0x51
	.byte 0x1E,0x22,0x22,0x1E,0x12,0x22,0x22,0x00	; 0x52
	.byte 0x1C,0x22,0x02,0x1C,0x20,0x22,0x1C,0x00	; 0x53
	.byte 0x3E,0x08,0x08,0x08,0x08,0x08,0x08,0x00	; 0x54
	.byte 0x22,0x22,0x22,0x22,0x22,0x22,0x1C,0x00	; 0x55
	.byte 0x22,0x22,0x22,0x22,0x22,0x14,0x08,0x00	; 0x56
	.byte 0x22,0x22,0x2A,0x2A,0x2A,0x2A,0x14,0x00	; 0x57
	.byte 0x22,0x22,0x14,0x08,0x14,0x22,0x22,0x00	; 0x58
	.byte 0x22,0x22,0x22,0x14,0x08,0x08,0x08,0x00	; 0x59
	.byte 0x1E,0x10,0x08,0x04,0x02,0x02,0x1E,0x00	; 0x5A
	.byte 0x1C,0x04,0x04,0x04,0x04,0x04,0x1C,0x00	; 0x5B
	.byte 0x00,0x02,0x04,0x08,0x10,0x20,0x00,0x00	; 0x5C
	.byte 0x1C,0x10,0x10,0x10,0x10,0x10,0x1C,0x00	; 0x5D
	.byte 0x08,0x14,0x22,0x00,0x00,0x00,0x00,0x00	; 0x5E
	.byte 0x00,0x00,0x00,0x00,0x00,0x00,0x00,0x3F	; 0x5F
	.byte 0x0C,0x0C,0x08,0x00,0x00,0x00,0x00,0x00	; 0x60
	.byte 0x00,0x00,0x1C,0x20,0x3C,0x22,0x3C,0x00	; 0x61
	.byte 0x02,0x02,0x1E,0x22,0x22,0x22,0x1E,0x00	; 0x62
	.byte 0x00,0x00,0x1C,0x22,0x02,0x22,0x1C,0x00	; 0x63
	.byte 0x20,0x20,0x3C,0x22,0x22,0x22,0x3C,0x00	; 0x64
	.byte 0x00,0x00,0x1C,0x22,0x1E,0x02,0x1C,0x00	; 0x65
	.byte 0x18,0x04,0x04,0x1E,0x04,0x04,0x04,0x00	; 0x66
	.byte 0x00,0x00,0x3C,0x22,0x22,0x3C,0x20,0x1C	; 0x67
	.byte 0x02,0x02,0x0E,0x12,0x12,0x12,0x12,0x00	; 0x68
	.byte 0x08,0x00,0x08,0x08,0x08,0x08,0x18,0x00	; 0x69
	.byte 0x10,0x00,0x18,0x10,0x10,0x10,0x12,0x0C	; 0x6A
	.byte 0x02,0x02,0x12,0x0A,0x06,0x0A,0x12,0x00	; 0x6B
	.byte 0x08,0x08,0x08,0x08,0x08,0x08,0x18,0x00	; 0x6C
	.byte 0x00,0x00,0x16,0x2A,0x2A,0x22,0x22,0x00	; 0x6D
	.byte 0x00,0x00,0x0E,0x12,0x12,0x12,0x12,0x00	; 0x6E
	.byte 0x00,0x00,0x1C,0x22,0x22,0x22,0x1C,0x00	; 0x6F
	.byte 0x00,0x00,0x1E,0x22,0x22,0x22,0x1E,0x02	; 0x70
	.byte 0x00,0x00,0x3C,0x22,0x22,0x22,0x3C,0x20	; 0x71
	.byte 0x00,0x00,0x1A,0x24,0x04,0x04,0x0E,0x00	; 0x72
	.byte 0x00,0x00,0x1C,0x02,0x1C,0x20,0x1C,0x00	; 0x73
	.byte 0x00,0x04,0x1E,0x04,0x04,0x14,0x08,0x00	; 0x74
	.byte 0x00,0x00,0x12,0x12,0x12,0x1A,0x14,0x00	; 0x75
	.byte 0x00,0x00,0x22,0x22,0x22,0x14,0x08,0x00	; 0x76
	.byte 0x00,0x00,0x22,0x22,0x2A,0x3E,0x14,0x00	; 0x77
	.byte 0x00,0x00,0x12,0x12,0x0C,0x12,0x12,0x00	; 0x78
	.byte 0x00,0x00,0x12,0x12,0x12,0x1C,0x08,0x06	; 0x79
	.byte 0x00,0x00,0x1E,0x10,0x0C,0x02,0x1E,0x00	; 0x7A
	.byte 0x18,0x04,0x04,0x06,0x04,0x04,0x18,0x00	; 0x7B
	.byte 0x08,0x08,0x08,0x00,0x08,0x08,0x08,0x00	; 0x7C
	.byte 0x0C,0x10,0x10,0x30,0x10,0x10,0x0C,0x00	; 0x7D
	.byte 0x14,0x0A,0x00,0x00,0x00,0x00,0x00,0x00	; 0x7E
	.byte 0x08,0x1C,0x36,0x22,0x22,0x3E,0x00,0x00	; 0x7F

FontEnd:

